ENTRY(_start)

OUTPUT_FORMAT(@LD_OUTPUT_FORMAT@)

SECTIONS {
	. = @LD_KERNEL_START_ADDRESS@;

	.multiboot_header : {
	}

	/* standard segments */
	.text : {
		KEEP (*(".multiboot"))
		*(".text.startup")

		_stext_fail = .;
		*(".text._Z*2os*")
		*(".text._Z*4fail*")
		"*libgcc*.a:" ( ".text" )
		_etext_fail = .;
		*(".text.test")
		_etext_fail_allowed = .;

		*(".text")

		_srodata = .;
		*(".rodata*")
		_erodata = .;
	}

	.ctors :
	{
		PROVIDE(__CTORS_START = .);
		KEEP (*(.ctors*))
		KEEP (*(.init_array*))
		PROVIDE(__CTORS_END = .);
	}

	.data :  {
		_sdata_fail = .;
		*(".data._Z*2os*")
		*(".data._Z*4fail*")
		_edata_fail = .;

		*(".data")
	}

	.bss : {
		_sbss = .;
		*(COMMON)
		*(".bss")
		_ebss = .;
	}

	.stack :  {
		*(".bootstrap_stack")
	}

	/*
	 * Get rid of unnecessary GCC bits.
	 */
	/DISCARD/ :
	{
		*(.comment)
		*(.eh_frame)
		*(.note.gnu.build-id)
	}
}
